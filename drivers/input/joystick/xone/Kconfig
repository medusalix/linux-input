## drivers/input/joystick/xone/Kconfig
```kconfig
# SPDX-License-Identifier: GPL-2.0-or-later

menuconfig JOYSTICK_XONE
	tristate "Xbox One/Series X|S accessories support"
	depends on POWER_SUPPLY && LEDS_CLASS && INPUT
	select CRYPTO
	select CRYPTO_HASH
	select CRYPTO_SHA256
	select CRYPTO_AKCIPHER
	select CRYPTO_RSA
	select CRYPTO_ECDH
	help
	  TODO.

if JOYSTICK_XONE

config JOYSTICK_XONE_WIRED
	tristate "Wired Xbox devices"
	depends on USB && !JOYSTICK_XPAD_XBOX_ONE
	help
	  TODO.

config JOYSTICK_XONE_GIP_GAMEPAD
	tristate "Xbox Controller support"
	select INPUT_FF_MEMLESS
	help
	  TODO.

config JOYSTICK_XONE_GIP_CHATPAD
	tristate "Xbox Chatpad support"
	depends on HID
	help
	  TODO.

config JOYSTICK_XONE_GIP_HEADSET
	tristate "Xbox Headset support"
	depends on SND
	select SND_PCM
	help
	  TODO.

endif # JOYSTICK_XONE
```
